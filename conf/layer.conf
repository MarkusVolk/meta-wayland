## conf/layer.conf
```bitbake
# We have a conf and classes directory, add to BBPATH
BBPATH .= ":${LAYERDIR}"

# We have recipes-* directories, add to BBFILES
BBFILES += "${LAYERDIR}/recipes-*/*/*.bb ${LAYERDIR}/recipes-*/*/*.bbappend"

BBFILE_COLLECTIONS += "wayland"
BBFILE_PATTERN_wayland = "^${LAYERDIR}/"
BBFILE_PRIORITY_wayland = "8"

LAYERSERIES_COMPAT_wayland = "nanbield"

LAYERDEPENDS_wayland = " \
	core \
	openembedded-layer \
"

BBFILES_DYNAMIC += " \
    qt6-layer:${LAYERDIR}/dynamic-layers/meta-qt6/*/*/*.bb \
    qt6-layer:${LAYERDIR}/dynamic-layers/meta-qt6/*/*/*.bbappend \
"
```
